/ {
	pro_micro: connector {
		compatible = "arduino-pro-micro";
		#gpio-cells = <2>;
		gpio-map-mask = <0xffffffff 0xffffffc0>;
		gpio-map-pass-thru = <0 0x3f>;
		gpio-map
			= <0 0 &gpio0 8 0>		/* D0 */
			, <1 0 &gpio0 6 0>		/* D1 */
			, <2 0 &gpio0 17 0>		/* D2 */
			, <3 0 &gpio0 20 0>		/* D3 */
			, <4 0 &gpio0 22 0>		/* D4/A6 */
			, <5 0 &gpio0 24 0>		/* D5 */
			, <6 0 &gpio1 0 0>		/* D6/A7 */
			, <7 0 &gpio0 11 0>		/* D7 */
			, <8 0 &gpio1 4 0>		/* D8/A8 */
			, <9 0 &gpio1 6 0>		/* D9/A9 */
			, <10 0 &gpio0 9 0>		/* D10/A10 */
			, <16 0 &gpio0 10 0>	/* D16 */
			, <14 0 &gpio1 11 0>	/* D14 */
			, <15 0 &gpio1 13 0>	/* D15 */
			, <18 0 &gpio1 15 0>	/* D18/A0 */
			, <19 0 &gpio0 2 0>	/* D19/A1 */
			, <20 0 &gpio0 29 0>	/* D20/A2 */
			, <21 0 &gpio0 31 0>	/* D21/A3 */
			;
	};

	pro_micro_a: connector_a {
		compatible = "arduino-pro-micro";
		#gpio-cells = <2>;
		gpio-map-mask = <0xffffffff 0xffffffc0>;
		gpio-map-pass-thru = <0 0x3f>;
		gpio-map
			= <0 0 &gpio1 15 0>	/* D18/A0 */
			, <1 0 &gpio0 2 0>	/* D19/A1 */
			, <2 0 &gpio0 29 0>	/* D20/A2 */
			, <3 0 &gpio0 31 0>	/* D21/A3 */
			, <6 0 &gpio0 22 0>	/* D4/A6 */
			, <7 0 &gpio1 0 0>	/* D6/A7 */
			, <8 0 &gpio1 4 0>	/* D8/A8 */
			, <9 0 &gpio1 6 0>	/* D9/A9 */
			, <10 0 &gpio0 9 0>	/* D10/A10 */
			;
	};
};

ext-power {
    compatible = "zmk,ext-power-generic";
    label = "EXT_POWER";
    control-gpios = <&gpio0 13 GPIO_ACTIVE_HIGH>;
    init-delay-ms = <50>;
};

vbatt: vbatt {
    compatible = "zmk,battery-nrf-vddh";
    label = "BATTERY";
};

&adc {
	status = "okay";
};

&gpiote {
	status = "okay";
};

&gpio0 {
	status = "okay";
};

&gpio1 {
	status = "okay";
};

&i2c0 {
	compatible = "nordic,nrf-twi";
	sda-pin = <17>;
	scl-pin = <20>;
};

&uart0 {
	compatible = "nordic,nrf-uarte";
	tx-pin = <6>;
	rx-pin = <8>;
};

&usbd {
	status = "okay";
	compatible = "nordic,nrf-usbd";
	cdc_acm_uart: cdc_acm_uart {
		compatible = "zephyr,cdc-acm-uart";
		label = "CDC_ACM_0";
	};
};

&flash0 {
	/*
	 * For more information, see:
	 * http://docs.zephyrproject.org/latest/devices/dts/flash_partitions.html
	 */
	partitions {
		compatible = "fixed-partitions";
		#address-cells = <1>;
		#size-cells = <1>;

		sd_partition: partition@0 {
			label = "mbr";
			reg = <0x00000000 0x00001000>;
		};
		code_partition: partition@1000 {
			label = "code_partition";
			reg = <0x00001000 0x000d3000>;
		};

		storage_partition: partition@d4000 {
			label = "storage";
			reg = <0x000d4000 0x00020000>;
		};

		boot_partition: partition@f4000 {
			label = "adafruit_boot";
			reg = <0x000f4000 0x0000c000>;
		};
	};
};

pro_micro_d: &pro_micro {};
pro_micro_i2c: &i2c0 {};
pro_micro_spi: &spi0 {};
pro_micro_serial: &uart0 {};