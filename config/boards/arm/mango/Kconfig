## config/boards/arm/mango/Kconfig
```kconfig
config BOARD_ENABLE_DCDC
	bool "Enable DCDC mode"
	select SOC_DCDC_NRF52X
	default y
	depends on (BOARD_MANGO_LEFT || BOARD_MANGO_RIGHT)
```

## config/boards/arm/mango/Kconfig.board
```kconfig
config BOARD_MANGO_LEFT
	bool "mango_left"
	depends on SOC_NRF52840_QIAA

config BOARD_MANGO_RIGHT
	bool "mango_right"
	depends on SOC_NRF52840_QIAA
```

## config/boards/arm/mango/Kconfig.defconfig
```kconfig
if BOARD_MANGO_LEFT

	config ZMK_KEYBOARD_NAME
	default "Mango"

	config ZMK_SPLIT_BLE_ROLE_CENTRAL
    default y

endif # BOARD_MANGO_LEFT

if BOARD_MANGO_RIGHT

	config ZMK_KEYBOARD_NAME
	default "Mango right"

endif # BOARD_MANGO_RIGHT

if BOARD_MANGO_LEFT || BOARD_MANGO_RIGHT

	config BOARD
		default "mango"

	config ZMK_SPLIT
		default y

	config ZMK_DISPLAY
		select LV_USE_CONT
		select LV_FONT_MONTSERRAT_26
		select LV_FONT_MONTSERRAT_20
		select LV_FONT_MONTSERRAT_16
		select LV_USE_LABEL
		select LV_USE_IMG

	if ZMK_DISPLAY

		config SYSTEM_WORKQUEUE_STACK_SIZE
			default 2048

		choice LV_FONT_DEFAULT
			default LV_FONT_DEFAULT_MONTSERRAT_26
		endchoice

		choice ZMK_LV_FONT_DEFAULT_SMALL
			default ZMK_LV_FONT_DEFAULT_SMALL_MONTSERRAT_26
		endchoice

		config LV_HOR_RES_MAX
			int "Max horizontal resolution"
			default 160

		config LV_VER_RES_MAX
			int "Max vertical resolution"
			default 68

		config SPI
			default y

		config LS0XX
			default y

		config LV_Z_BITS_PER_PIXEL
			default 1

		choice LV_COLOR_DEPTH
			default LV_COLOR_DEPTH_1
		endchoice

		config LV_DPI_DEF
			default 30

		config LV_Z_VDB_SIZE
			default 16

		choice ZMK_DISPLAY_STATUS_SCREEN
			default ZMK_DISPLAY_STATUS_SCREEN_CUSTOM
		endchoice

	endif # ZMK_DISPLAY

	if USB_DEVICE_STACK

		config USB_NRFX
			default y

	endif # USB_DEVICE_STACK

	config BT_CTLR
	default BT

	config ZMK_BLE
		default y

	config ZMK_USB
		default y

	menuconfig CUSTOM_WIDGET_BATTERY_STATUS
		bool "custom battery status widget"

	menuconfig CUSTOM_WIDGET_OUTPUT_STATUS
		bool "custom output status widget"

	menuconfig CUSTOM_WIDGET_LAYER_STATUS
		bool "custom layer status widget"

	config ZMK_WIDGET_LUNA_STATUS
		bool "widget for displaying luna"
		depends on !ZMK_SPLIT || ZMK_SPLIT_ROLE_CENTRAL
		select LV_USE_IMG
		select LV_USE_ANIMATION
		select ZMK_WPM

	config ZMK_WIDGET_LUNA_WIDGET_WALK_WPM
		int "Lower limit for WPM for luna to start walking"
		default 10

	config ZMK_WIDGET_LUNA_WIDGET_RUN_WPM
		int "Lower limit for WPM for luna to start running"
		default 40

	config ZMK_WIDGET_LUNA_WIDGET_FRAME_DURATION
		int "Luna animation frame duration"
		default 200

endif # BOARD_MANGO_LEFT || BOARD_MANGO_RIGHT
```

## config/boards/arm/mango/mango_left_defconfig
```kconfig
# Deep Sleep
# CONFIG_ZMK_SLEEP=y

# RGB Underglow
# CONFIG_ZMK_RGB_UNDERGLOW=y

# Displays
CONFIG_ZMK_DISPLAY=y

# Custom Status Screens
# CONFIG_ZMK_DISPLAY_STATUS_SCREEN_CUSTOM=y
CONFIG_ZMK_DISPLAY_STATUS_SCREEN_BUILT_IN=y

# CONFIG_CUSTOM_WIDGET_BATTERY_STATUS=y
CONFIG_ZMK_WIDGET_BATTERY_STATUS=y

# CONFIG_CUSTOM_WIDGET_LAYER_STATUS=y
# CONFIG_ZMK_WIDGET_LAYER_STATUS=y

# CONFIG_CUSTOM_WIDGET_OUTPUT_STATUS=y
# CONFIG_ZMK_WIDGET_OUTPUT_STATUS=y

# Theme Mono
CONFIG_LVGL_USE_THEME_MONO=y

# Enable MPU
CONFIG_ARM_MPU=y

# enable GPIO
CONFIG_GPIO=y

CONFIG_USE_DT_CODE_PARTITION=y
CONFIG_BUILD_OUTPUT_UF2=y

CONFIG_MPU_ALLOW_FLASH_WRITE=y
CONFIG_NVS=y
CONFIG_SETTINGS_NVS=y
CONFIG_FLASH=y
CONFIG_FLASH_PAGE_LAYOUT=y
CONFIG_FLASH_MAP=y

CONFIG_SOC_SERIES_NRF52X=y
CONFIG_SOC_NRF52840_QIAA=y
```

## config/boards/shields/mango/Kconfig.defconfig
```kconfig
if SHIELD_MANGO_LEFT

config ZMK_MANGO
    default "Mango"

config ZMK_SPLIT_ROLE_CENTRAL
    default y

endif

if SHIELD_MANGO_LEFT || SHIELD_MANGO_RIGHT

config ZMK_SPLIT
    default y

endif
```

## config/boards/shields/mango/Kconfig.shield
```kconfig
config SHIELD_MANGO_LEFT
    def_bool $(shields_list_contains,mango_left)

config SHIELD_MANGO_RIGHT
    def_bool $(shields_list_contains,mango_right)
```
